## config/boards/shields/lily58_oled/Kconfig.defconfig
```kconfig
if SHIELD_LILY58_OLED

config LV_FONT_MONTSERRAT_12
    bool
    default y

config ZMK_DISPLAY_DEDICATED_THREAD_STACK_SIZE
    default 2048

endif
```
